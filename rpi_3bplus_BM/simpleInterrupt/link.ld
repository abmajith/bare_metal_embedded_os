ENTRY(_start)

SECTIONS
{
    . = 0x80000;

    .text.boot : {
        *(.text.boot)
    }

    .text : {
        *(.text)
    }

    .rodata : {
        *(.rodata)
    }

    .data : {
        *(.data)
    }

    .bss : {
        __bss_start = .;
        *(.bss)
        __bss_end = .;
    }
}
__bss_size = (__bss_end - __bss_start) >> 3;

